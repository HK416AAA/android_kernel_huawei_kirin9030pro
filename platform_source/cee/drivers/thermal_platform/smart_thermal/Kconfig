## platform_source/cee/drivers/thermal_platform/smart_thermal/Kconfig
```kconfig
config SMART_THERMAL
	bool "smart thermal driver config"
	default n
	select SMART_THERMAL_SYSFS
	help
	  Driver for Smart thermal

config SMART_THERMAL_SYSFS
	bool "smart thermal driver config"
	depends on SMART_THERMAL
	default n
	help
	  Enable sysfs for Smart thermal

config SMART_THERMAL_IOCTL
	bool "smart thermal ioctl"
	depends on SMART_THERMAL
	default n
	help
	  Enable Smart thermal ioctl

config THERMAL_AI_SCHED
	bool "enable thermal ai sched"
	depends on IPA_THERMAL
	depends on SMART_THERMAL_IOCTL
	default n
	help
	  Enable thermal ai sched

source "platform_source/cee/drivers/thermal_platform/smart_thermal/margin_thermal/Kconfig"
```

## platform_source/cee/drivers/thermal_platform/smart_thermal/margin_thermal/Kconfig
```kconfig
config THERMAL_OFFLOADING
	bool "enable thermal offloading"
	depends on IPA_THERMAL
	depends on THERMAL_SHELL
	default n
	help
	  Enable thermal offloading

config THERMAL_GOV_MARGIN_CTRL
	bool "enable margin thermal"
	depends on IPA_THERMAL
	depends on THERMAL_SHELL
	default n
	help
	  Enable margin thermal

config THERMAL_POWER_QUOTA
	bool "enable power quota"
	depends on THERMAL_GOV_MARGIN_CTRL
	depends on THERMAL_OFFLOADING
	default n
	help
	  Enable power quota

config OPT_POWER_MODEL
	bool "enable opt power model"
	depends on THERMAL_POWER_QUOTA
	default n
	help
	  Enable opt power model
```

## platform_source/cee/drivers/vddmin_debug/Kconfig
```kconfig
menu "vddmin_debug options"

config VDDMIN_DEBUG
	depends on IPC_MAILBOX
	bool "VDDMIN debug"
	default n
	help
	  vddmin debug drivers

endmenu
```

## platform_source/cee/kernel/sched/Kconfig
```kconfig
# SPDX-License-Identifier: GPL-2.0

config SCHED_LTS
	bool "sched feature support LTS kernel"
	default n
	help
	  Say Y here if OHOS LTS kernel
	  Say N here if ASOP kernel

config FRAME_WINDOW
	bool "get frame rate in kernel"
	default n

config SOC_DFX
	bool "dfx switch"
	default n

config HISI_PTR_FEATURE
	bool "Performance thermal rebalancing "
	default n

config BENCHMARK_USE_ST_CORES_WORKAROUND
	bool "Temporary workaround for issues that two threads benchmark runs on big core MT mode"
	default n
```

## platform_source/display/drivers/cdc_rda/Kconfig
```kconfig
menu "rda display Kernel Configuration"

source "platform_source/display/drivers/cdc_rda/drm/Kconfig"
source "platform_source/display/drivers/cdc_rda/indep_rst/Kconfig"
source "platform_source/display/drivers/cdc_rda/vfb/Kconfig"

endmenu
```

## platform_source/display/drivers/cdc_rda/indep_rst/Kconfig
```kconfig
config DPU_INDEP_RST_VM_CTRL
    bool "dpu indep rst vm control"
    default n
    help
        This config controls dpu indep rst on the system.
```

## platform_source/display/drivers/cdc_rda/vfb/Kconfig
```kconfig
config VFB_BE
	bool "backend of vfb"
	help
	  Say Y here, if you want to have backend support of vfb.

config DISPLAY_ENG
        bool "display eng support"
        default n
        help
          Say yes here to support the display eng
```

## platform_source/ffrt/Kconfig
```kconfig
menu "FFRT Kernel Configuration"

config FFRT_DEBUG
	tristate "FFRT_DEBUG"
	default n

-source "platform_source/ffrt/ffts/Kconfig"
-source "platform_source/ffrt/hts/Kconfig"
-source "platform_source/ffrt/uniform_id/Kconfig"

endmenu
```

## platform_source/ffrt/ffts/Kconfig
```kconfig
config FFRT_FFTS
	tristate "FFRT_FFTS"
	default n

config FFRT_FFTS_VERSION
    string "FFRT_FFTS_VERSION"
    default ""
	depends on FFRT_FFTS
 
config FFTS_NOT_SEND_EVENT_TO_RTB
	bool "FFTS_NOT_SEND_EVENT_TO_RTB"
	default n
	depends on FFRT_FFTS
```

## platform_source/ffrt/hts/Kconfig
```kconfig
config FFRT_HTS
	tristate "FFRT_HTS"
	default n
	help
	Say m here to support hts kernel driver ko.

config FFRT_HTS_VERSION
	string "FFRT_HTS_VERSION"
    default ""
	depends on FFRT_HTS
```

## platform_source/see/drivers/dev_secinfo/Kconfig
```kconfig
config SECURITY_INFO
	bool "Support security info"
	default n
	help
	security info support

config CRYPTO_HICRYPTO_CCZ
	tristate "Support security info call tee to set hicrypto ccz key"
	depends on SECURITY_INFO
	default n
	help
	  Call tee to set hicrypto ccz key

config CRYPTO_HICRYPTO_TEE_OEM_MAC
	tristate "Support hicrypto throught security info call tee to calculate oem mac"
	depends on SECURITY_INFO
	default n
	help
	  Call tee to calculate oem mac
```
