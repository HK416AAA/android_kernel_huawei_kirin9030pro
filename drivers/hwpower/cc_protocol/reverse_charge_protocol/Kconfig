## drivers/hwpower/cc_protocol/reverse_charge_protocol/Kconfig
```kconfig
# SPDX-License-Identifier: GPL-2.0
#
# huawei reverse charge protocol drivers
#

config REVERSE_CHARGE_PROTOCOL
	bool "reverse charge protocol"
	depends on REVERSE_CHARGE
	default n
	help
	  Say Y here to enable reverse charge protocol driver.
	  This driver provides a unified interface to the reverse charge protocol.
	  Currently supported protocols as below:
	  Huawei SCP protocol.

config REVERSE_PROTOCOL_SCP
	bool "huawei reverse charge protocol with scp"
	depends on REVERSE_CHARGE_PROTOCOL
	default n
	help
	  Say Y here to enable reverse charge scp protocol driver.
	  The reverse charge protocol is used to communicate between a slave
	  device and a master device over a d+/d- bus. The protocol driver is
	  meant to be used to configure, control and read the status of
	  a master device.

config REVERSE_PROTOCOL_UFCS
	bool "huawei reverse charge protocol with ufcs"
	depends on REVERSE_CHARGE_PROTOCOL
	default n
	help
	  Say Y here to enable reverse charge ufcs protocol driver.
	  The reverse charge protocol is used to communicate between a slave
	  device and a master device over a d+/d- bus. The protocol driver is
	  meant to be used to configure, control and read the status of
	  a master device.
```

## drivers/platform_drivers/modem/drv/avs/Kconfig
```kconfig
config AVS_PERCHIP_UPDATE
    tristate "support avs perchip"
	default n
	help
	support for avs perchip

config AVS_COLL_TEST
	tristate "support avs coll test"
	default n
	help
	support for avs coll test
```

## drivers/platform_drivers/modem/drv/pcv_adaptor/Kconfig
```kconfig
#
# v2x_agent
#
 
config V2X_AGENT
    tristate "v2x agent driver"
    default n
 
config V2X_AGENT_DUMP
    bool "v2x agent dump"
    depends on V2X_AGENT
    default n
```
