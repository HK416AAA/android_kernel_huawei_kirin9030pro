## platform_source/ai/drivers/npu/npd/ldk/npu_v311/changsha/npu_user_defconfig
```kconfig
CONFIG_NPU_KERNEL_DRIVER=m
CONFIG_NPU_PLATFORM_DRIVER=m
CONFIG_NPU_BBIT_DEBUGFS=m
CONFIG_CONTEXTHUB_IGS=m
CONFIG_CONTEXTHUB_IGS_DBG=m
CONFIG_CONTEXTHUB_IGS_TOF=m
CONFIG_CONTEXTHUB_IGS_CAM=m
CONFIG_VENDOR_CHIP_SUFFIX="es"
```

## platform_source/audio/drivers/hifi_dsp/audio_cognition/Kconfig
```kconfig
config AUDIO_COGNITION
	bool "notify audio cognition data to user"
	default n

config AUDIO_BLOW_COGNITION
	bool "support audio blow cognition driver"
	depends on AUDIO_COGNITION
	default n
	help
		support audio blow cognition driver

config AUDIO_ENV_SOUND_COGNITION
	bool "support audio enviroment cognition driver"
	depends on AUDIO_COGNITION
	default n
	help
		support audio enviroment cognition driver

config AUDIO_EMOTION_COGNITION
	bool "support audio emotion cognition driver"
	depends on AUDIO_COGNITION
	default n
	help
		support audio emotion cognition driver

config AUDIO_NOISE_SOUND_COGNITION
	bool "support audio noise sound cognition driver"
	depends on AUDIO_COGNITION
	default n
	help
		support audio noise sound cognition driver

config AUDIO_ENV_NOISE_COGNITION
	bool "support audio enviroment noise cognition driver"
	depends on AUDIO_COGNITION
	default n
	help
		support audio enviroment noise cognition driver
```

## platform_source/audio/drivers/soc_mad/Kconfig
```kconfig
config SOC_MAD
	tristate "audio mad support"
config MAD_STATE_CHECK
	tristate "support mad state check"
	depends on SOC_MAD
	default n
source "platform_source/audio/drivers/soc_mad/mad_extension/Kconfig"
```

## platform_source/audio/rda/ldk/Kconfig
```kconfig
menu "audio Kernel Configuration"

RDA_AUDIO_SRC_PATH := $(if-success,[ -d $(srctree)/platform_source/audio/rda/ldk ],platform_source/audio/rda/ldk,vendor/drivers/audio)

menuconfig RDA_AUDIO_DRIVERS
	bool "Enable RDA audio drivers"
	default n
	help
	Say yes here to support RDA audio drivers

source "$(RDA_AUDIO_SRC_PATH)/hifi_dsp/Kconfig"
source "$(RDA_AUDIO_SRC_PATH)/codecs/Kconfig"
source "$(RDA_AUDIO_SRC_PATH)/hifi_mailbox/Kconfig"
source "$(RDA_AUDIO_SRC_PATH)/rda_rdr/Kconfig"
source "$(RDA_AUDIO_SRC_PATH)/a2b/Kconfig"

endmenu
```

## platform_source/audio/rda/ldk/a2b/Kconfig
```kconfig
menu "rda a2b driver"

config RDA_A2B_DRIVER
	bool "RDA_A2B_DRIVER"
	default y
	help
	Say yes here if you want to configure RDA_A2B_DRIVER

config RDA_A2B_DEBUG
	bool "RDA_A2B_DEBUG"
	default n
	help
	Say yes here if you want to open debug function of RDA_A2B_DRIVER

endmenu
```

## platform_source/audio/rda/ldk/codecs/Kconfig
```kconfig
menu "Codec Driver"

config RDA_CODEC_DRV
	bool "rda codec driver support"
	default n
	help
	  rda codec driver

endmenu
```

## platform_source/audio/rda/ldk/hifi_dsp/Kconfig
```kconfig
menu "Hifimisc driver serve HIFI dsp"

if RDA_AUDIO_DRIVERS

config HIFI_DSP_ONE_TRACK
     bool "hifi low power play device support"
     help
          hifi lpp device provide service for HIFI and AP, in case of HIFI ultra-low power audio play.

config AUDIO_DEBUG
    bool "support audio debug function"
    help
        support audio debug function

config AUDIO_NRDA_RESET
    bool "nrda audio reset support"

config RDA_HIFI_DSP_DRV
     bool "rda hifi dsp support"
     help
          rda hifi dsp.

config HIFI_MEMORY_21M
    bool "hifi memory is 21M"
    help
         hifi memory is 21M

config AUDIO_RELOAD_HIFI_ON_TZSP
    bool "for rda, reload hifi on tzsp"
    depends on PLATDRV_SUPPORT_FFA
    default n
    help
        audio reload hifi on tzsp.

endif

endmenu
```

## platform_source/audio/rda/ldk/hifi_mailbox/Kconfig
```kconfig
source "$(RDA_AUDIO_SRC_PATH)/hifi_mailbox/ipcm/Kconfig"
source "$(RDA_AUDIO_SRC_PATH)/hifi_mailbox/mailbox/Kconfig"
```

## platform_source/audio/sound/Kconfig
```kconfig
menu "sound Configuration"

config AUDIO_OFFLOAD_INNER_RECORD
    bool "audio pcm offload inner record driver support"
    default n
    help
        for audio pcm offload inner record featured.
source "platform_source/audio/sound/soc/platforms/Kconfig"
source "platform_source/audio/sound/soc/codecs/Kconfig"
source "platform_source/audio/sound/usb/hifi/Kconfig"
source "platform_source/audio/sound/usb/usbaudio_mailbox/Kconfig"
endmenu
```

## platform_source/audio/sound/soc/codecs/Kconfig
```kconfig
config SND_SOC_DA_COMBINE_V3
	tristate "Support Sound SoC DA combine v3 Codec"
	depends on DA_COMBINE_V3_CODEC

config SND_SOC_DA_COMBINE_V5
	tristate "Support Sound SoC DA combine v5 Codec"


config SND_SOC_DP_AUDIO
	tristate "Support Sound SoC DP audio"

# Supported au pa
source "platform_source/audio/sound/soc/codecs/vendor/au_pa/Kconfig"

config SND_SOC_CODEC_DA_SEPARATE_V2
	tristate "Soc Smartstar Codec DA separate v2 support"

config SND_SOC_CODEC_DEBUG
	bool "Codec debug support"

config SND_SOC_ASP_CODEC
	tristate "Soc Smartstar asp codec"

config SND_SOC_ASP_CODEC_CODECLESS
	tristate "Soc Smartstar asp codec for codecless support"

config SND_SOC_ASP_CODEC_ANA
	tristate "Soc Smartstar asp codec for ana support"

config DISABLE_REGULATOR_WHEN_RUNTIME_SUSPEND
	tristate "disable asp regulator when runtime_suspend"

config SND_SOC_ASP_CODEC_SUPPORT_HWSPIN_LOCK
	bool "asp codec support hwspin lock"

config AUDIO_SR_NO_RESOURCE_OPERATION
	tristate "Audio suspend and resume no resource operation"

config AUDIO_NOT_SUPPORT_AXI2TDM_INTF3
	tristate "Audio asp codec dose not support axi2tdm intf3"

config ASP_CODEC_RESOURCE_SHARED_WITH_SENSORHUB
	tristate "asp codec resource with sensorhub"

# Support codecless series audio ana codec
source "platform_source/audio/sound/soc/codecs/vendor/asp_codec_ana/Kconfig"

# Supported da separate codecs
source "platform_source/audio/sound/soc/codecs/vendor/legacy/da_separate/Kconfig"
```

## platform_source/basicplatform/drivers/dma-buf/dmabuf_reclaim/Kconfig
```kconfig
config DMABUF_SWAP
    bool "dmabuf swap"
    depends on DMABUF_HEAPS
    help
      Choose this option to enable dmabuf swap of System Heap.
      To store or resume the memory data from the UFS.

config DMABUF_ZSWAP
    bool "dmabuf zswap"
    depends on DMABUF_SWAP
    help
      Choose this option to enable dmabuf swap of System Heap.
      To store or resume the memory data from the storage.

config DMABUF_RECLAIM
    bool "dmabuf reclaim"
    select ION_FAULT
    depends on DMABUF_HEAPS
    help
      Choose this option to enable Dmabuf Reclaim of System Heap.
      Reclaiming and restoring

config DMABUF_RECLAIM_TEST
    bool "dmabuf reclaim test"
    depends on DMABUF_RECLAIM || DMABUF_SWAP
    help
      Choose this option to enable Dmabuf test program.

config DMABUF_RESUME_PIPELINE
    bool "dmabuf resume pipeline"
    depends on DMABUF_RECLAIM
    default n
    help
      Choose this option to enable Dmabuf resume pipeline

config DMABUF_RECLAIM_SUPPORT_UVAMAP_DEAD
    bool "dmabuf_reclaim support for died process uva_map"
    depends on DMABUF_RECLAIM
    default n
    help
      Choose this option to support for died or unmapping process uva_map
```

## platform_source/basicplatform/drivers/dma-buf/mm/Kconfig
```kconfig
config MM_DMA_HEAP_FLUSH_CACHE_ALL
	bool "Enable flush all cpu cache when alloc mm dma-heap memory"
	depends on DMABUF_HEAPS
	help
	  When alloc from mm dma-heap memory, flush all cpu caches regardless of cpu-idle status.

config DFX_DMABUF_HEAPS
	bool "dump dmabuf info"
	depends on DMABUF_HEAPS
	help
	  Choose this option to enable dump Dmabuf info.

config DMABUF_HEAPS_REF_TRACK
	bool "record dmabuf refcount info"
	depends on DMABUF_HEAPS
	help
	  Choose this option to record Dmabuf refcount info.
```

## platform_source/basicplatform/drivers/mntn/dfx_improve_yield/Kconfig
```kconfig
config DFX_IMPROVE_YIELD
	bool "DFX IMPROVE YIELD"
	depends on IMPROVE_YIELD
	default n
	help
		Say 'Y' here if you want to use enable dfx improve yield
```

## platform_source/basicplatform/drivers/mntn/dfx_sh/Kconfig
```kconfig
config DFX_SH
	bool "DFX sh driver"
	default n
	help
		Say 'Y' here if you want to use enable dfx sh

config DFX_SH_DDR
	bool "DFX sh ddr driver"
	depends on DFX_SH
	default n
	help
		Say 'Y' here if you want to use enable dfx sh ddr
		
config DFX_SH_TBC
	bool "DFX sh time based compensation"
	depends on DFX_SH
	default n
	help
		Say 'Y' here if you want to enable time based compensation

config DFX_SH_HFRC
	bool "DFX sh time based compensation"
	depends on DFX_SH
	default n
	help
	Say 'Y' here if you want to enable time based compensation

config DFX_SH_LU
	bool "DFX sh lu driver"
	depends on DFX_SH
	default n
	help
		Say 'Y' here if you want to use enable dfx lu sh
config DFX_SH_AHBTIEMOUT
	bool "DFX sh for ahb_timeout"
	depends on DFX_SH
	default n
	help
		Say 'Y' here if you want to use enable dfx ahb_timeout sh
```

## platform_source/basicplatform/drivers/perchip_vmin/Kconfig
```kconfig
config PERCHIP_VMIN
	bool "soc perchip vmin"
	default n
	help
		Say 'Y' here if you want to save perchip vmin to diaginfo
```

## platform_source/basicplatform/drivers/pwm/Kconfig
```kconfig
# SPDX-License-Identifier: GPL-2.0

config PWM_HISI
	bool "hisilicon kirin pwm"
	default n

config BLPWM
	bool "hisilicon kirin pwm"
	default n

config BLPWM_LAMP
	bool "hisilicon kirin pwm lamp"
	default n

config BLPWM_TEST
	bool "hisilicon kirin pwm"
	depends on BLPWM
	help
		This keep blpwm_test case open or not.
		If unsure, say n.

config FACTORY_POWER_LED
	bool "control power_led factory interface"
	default n
```

## platform_source/basicplatform/drivers/ufs_wrapper/Kconfig
```kconfig
config UFS_WRAPPER
	bool "ufs wrapper"
	depends on LIBLINUX
	default n
	help
	  this select ufs wrapper for ldk & udk
```

## platform_source/camera/drivers/media/native/camera/laser/mt380xx/mt380x/Kconfig
```kconfig
config MT380X
	tristate "MT380X I2C DEVICE"
	depends on I2C && SYSFS
	help
	  Using I2C
```

## platform_source/camera/drivers/media/native/camera/laser/vi53xx/vi5302/Kconfig
```kconfig
config VI5302
	tristate "VI5302 I2C DEVICE"
	depends on I2C && SYSFS
	help
		Using I2C
```

## platform_source/camera/drivers/media/native/camera/sensor/pv_shield/Kconfig
```kconfig
if KERNEL_CAMERA_PVSHIELD

menu "Camera pvshield driver support"

endmenu

endif
```

## platform_source/cee/drivers/ddrc/big_model_monitor/Kconfig
```kconfig
config BIG_MODEL_MONITOR
	bool "big model monitor"
	default n
	help
	  big model monitor driver

menuconfig BIG_MODEL_MONITOR_GPU
	bool "big model monitor with gpuload"
	default n
	depends on BIG_MODEL_MONITOR
	help
	  big model monitor gpuload driver

menuconfig BIG_MODEL_MONITOR_CPU
	bool "big model monitor with cpuload"
	default n
	depends on BIG_MODEL_MONITOR
	help
	  big model monitor cpuload driver
```
