## drivers/communication/Kconfig
```kconfig
-source "drivers/communication/dpa/Kconfig"

config DPA_PROTO
	bool "support dpa proto"
	default n
	help
		This is dpa proto

config DPA_API
	bool "support dpa API"
	default n
	help
		This is dpa API
```

## drivers/communication/dpa/Kconfig
```kconfig
menu "DPA"

config DPA_DRIVERS
	tristate "support dpa drivers"
	default n
	help
		If you enable this option and choose 'y', it will be compiled in.
		If you choose 'm', it will be compiled as a module.
		If you choose 'n', it will not be compiled.
source "drivers/communication/dpa/compile_demo/Kconfig"
source "drivers/communication/dpa/proto/Kconfig"
source "drivers/communication/dpa/proto_om/Kconfig"
source "drivers/communication/dpa/remoteproc/Kconfig"
source "drivers/communication/dpa/traffic_control/Kconfig"
source "drivers/communication/dpa/mntn/Kconfig"
source "drivers/communication/dpa/sms/Kconfig"
source "drivers/communication/dpa/udx/Kconfig"
source "drivers/communication/dpa/chr/Kconfig"
source "drivers/communication/dpa/booster/Kconfig"
source "drivers/communication/dpa/pm_agent/Kconfig"
endmenu
```

## drivers/communication/dpa/booster/Kconfig
```kconfig
#
# dpa booster configuration
#
 
comment "dpa booster"
 
config DPA_BOOSTER
	bool "support dpa booster"
	depends on DPA_DRIVERS
	default n
	help
		This is dpa booster
```

## drivers/communication/dpa/chr/Kconfig
```kconfig
#
# dpa chr configuration
#

comment "dpa chr"

config DPA_CHR
	bool "support dpa chr"
	depends on DPA_DRIVERS
	default n
	help
		This is dpa chr

comment "dpa web chr"
 
config DPA_CHR_WEB
	bool "support dpa web chr"
	depends on DPA_DRIVERS
	default n
	help
		This is dpa web chr
```

## drivers/communication/dpa/compile_demo/Kconfig
```kconfig
#
# dpa compile demo
#

comment "kernel dpa compile demo"

config DPA_COMPILE_DEMO
	tristate "support dpa compile demo"
	default n
	help
		this is DPA_COMPILE_DEMO
```

## drivers/communication/dpa/configs/nanchang/kconfig/dpa_user_defconfig
```kconfig
#compile dpa
CONFIG_DPA_DRIVERS=m

#demo
#CONFIG_DPA_COMPILE_DEMO=y

#dump
CONFIG_DPA_MINI_DUMP=y
#CONFIG_DPA_FULL_DUMP=y
CONFIG_ACPU_RDR_DPA_FEATURE_ON=y

#dmi
CONFIG_DPA_DMI=y

#dra
CONFIG_DPA_DRA=y
CONFIG_DRA_PAGE=y
CONFIG_DPA_DRA_SMMU=n

#syscache
CONFIG_DPA_SC_GID_CTRL=y

#rpm
CONFIG_DPA_PM=y

#reset
CONFIG_DPA_RESET=y
CONFIG_DPA_RESET_DEBUG=n
CONFIG_DPA_MDM_RESET_AGENT=y

#netom
CONFIG_DPA_NET_OM=y

#dshell
#CONFIG_DSHELL_HOST=y

#syslog
CONFIG_DPA_SYSLOG=y

#wdt
CONFIG_DPA_WDT=y
#ocd user close
# CONFIG_DPA_OCD=y

#diag
CONFIG_DPA_HOST_DIAG=y

#busprobe
CONFIG_MDMPERI_QIC=y

#ldk proto hook define,todo delete
CONFIG_DPA_PROTO=y

#dpa proto
CONFIG_DPA_NSTACK=y

#wlist
CONFIG_DPA_WHITE_LIST=y
CONFIG_DPA_WHITE_LIST_NODE=n

#sms 
CONFIG_DPA_SMS=y

#sms dap netdev,todo del
CONFIG_DPA_NETDEV=y

#sms dpa gso,todo del
CONFIG_DPA_SMS_GSO=y

#sms dpa gro,todo del
CONFIG_DPA_SMS_GRO=y

#sms filter
CONFIG_DPA_SMS_FILTER=y

#tc
CONFIG_DPA_TC=y

#stack om
CONFIG_DPA_PROTO_OM=y
CONFIG_DPA_OM_FUZZY_OFF=y

#udx http
CONFIG_UDX_HTTP=y

#udx_server
CONFIG_UDX_SERVER=y

#udx buffer
CONFIG_UDX_BUFFER=y

#udx dfs
CONFIG_UDX_DFS=n

#udx dss
CONFIG_UDX_DSS=n

#chr
CONFIG_DPA_CHR=y

#chr_web
CONFIG_DPA_CHR_WEB=y

#dpa_sampler
CONFIG_DPA_SAMPLER=n
```

## drivers/communication/dpa/mntn/Kconfig
```kconfig
menu "DPA MNTN"

config DPA_FULL_DUMP
	tristate "support dpa full dump"
	default n
	help
		If you enable this option and choose 'y', dpa full ram dump and other dump functions will be force enable.
		If you choose 'n', fulldump depends on beta status, if not beta version, no dpa ram dump will saved.

config ACPU_RDR_DPA_FEATURE_ON
	tristate "support use RDR_DPA to reset and dump dpa"
	default n
	help
		If you enable this option and choose 'y', will use RDR_DPA to dump and reset dpa. note rdr in ap must support RDR_DPA before enable this config.
		If you choose 'n', will use RDR_MODEMAP to dump and reset dpa.

config MDMPERI_QIC
	tristate "support dpa and mdmperi qic dump"
	default n
	help
		If you enable this option and choose 'y', support qic process.
		If you choose 'n', no err report when dpa and mdmperi qic trigger bus err

config DPA_SYSLOG
	tristate "support dpa syslog"
	default n
	help
		If you enable this option and choose 'y', support syslog process.
		If you choose 'n', no syslog record

config DPA_WDT
	tristate "support dpa wdt"
	default n
	help
		If you enable this option and choose 'y', support watchdog.
		If you choose 'n', no watchdog

config DPA_OCD
	tristate "support dpa ocd"
	default n
	help
		If you enable this option and choose 'y', support ocd.
		If you choose 'n', no ltrace record

config DPA_HOST_DIAG
	tristate "support dpa diag"
	default n
	help
		If you enable this option and choose 'y', it will be compiled in.
		If you choose 'n', it will not be compiled.
endmenu
```

## drivers/communication/dpa/pm_agent/Kconfig
```kconfig
#
# dpa booster configuration
#
 
comment "dpa pm mntn"
 
config DPA_PM_MNTN
	bool "support dpa pm mntn"
	depends on DPA_DRIVERS
	default y
	help
		This is dpa pm mntn
```

## drivers/communication/dpa/proto/Kconfig
```kconfig
#
# dpa proto configuration
#

comment "dpa proto"

config DPA_PROTO
	bool "support dpa proto"
	default n
	help
		This is dpa proto

config DPA_LWIPSTACK
	bool "dpa lwip proto"
	depends on DPA_PROTO
	help
		The proto is lwip stack

config DPA_NSTACK
	bool "dpa nstack proto"
	depends on DPA_PROTO
	help
		The proto is nstack
```

## drivers/communication/dpa/proto_om/Kconfig
```kconfig
#
# dpa proto om configuration
#

comment "dpa proto_om"

config DPA_PROTO_OM
	bool "support dpa proto_om"
	depends on DPA_DRIVERS
	default n
	help
		This is dpa proto om

config DPA_OM_FUZZY_OFF
	bool "support dpa fuzzy disable"
	depends on DPA_DRIVERS
	default n
	help
		This is dpa proto om hids
```

## drivers/communication/dpa/remoteproc/Kconfig
```kconfig
menu "DPA REMOTEPROC"

config DPA_DMI
	tristate "support dpa dmi"
	default n
	help
		If you enable this option and choose 'y', it will be compiled in.
		If you choose 'm', it will be compiled as a module.
		If you choose 'n', it will not be compiled.

config DPA_DRA
	tristate "support dpa dra"
    default n
	help
		If you enable this option and choose 'y', it will be compiled in.

config DRA_PAGE
	tristate "support dra page"
    default n
	help
		If you enable this option and choose 'y', it will be compiled in.

config DPA_DRA_SMMU
	tristate "support dpa dra smmu"
	default n
	help
		If you enable this option and choose 'y', it will be compiled in.

config DSHELL_HOST
	tristate "support dpa shell"
	default n
	help
		If you enable this option and choose 'y', it will be compiled in.
		If you choose 'm', it will be compiled as a module.
		If you choose 'n', it will not be compiled.

config DPA_SC_GID_CTRL
	tristate "support dpa syscache"
	default n
	help
		If you enable this option and choose 'y', it will be compiled in.
		If you choose 'm', it will be compiled as a module.
		If you choose 'n', it will not be compiled.

config DPA_NET_OM
	tristate "support dpa netom"
	default n
	help
		If you enable this option and choose 'y', it will be compiled in.
		If you choose 'm', it will be compiled as a module.
		If you choose 'n', it will not be compiled.

config DPA_DFA
	tristate "support dpa dfa"
	default n
	help
		If you enable this option and choose 'y', it will be compiled in.
		If you choose 'm', it will be compiled as a module.
		If you choose 'n', it will not be compiled.

config DPA_PM
	tristate "support dpa rpm"
	default n
	help
		If you enable this option and choose 'y', it will be compiled in.
		If you choose 'm', it will be compiled as a module.
		If you choose 'n', it will not be compiled.

config DPA_RESET
	tristate "support dpa reset"
	default n
	help
		If you enable this option and choose 'y', it will be compiled in.
		If you choose 'm', it will be compiled as a module.
		If you choose 'n', it will not be compiled.

config DPA_RESET_DEBUG
	tristate "support dpa reset debug"
	default n
	help
		If you enable this option and choose 'y', it will be compiled in.
		If you choose 'm', it will be compiled as a module.
		If you choose 'n', it will not be compiled.

config DPA_MDM_RESET_AGENT
	tristate "support dpa mdm reset agent"
	default n
	help
		If you enable this option and choose 'y', it will be compiled in.
		If you choose 'm', it will be compiled as a module.
		If you choose 'n', it will not be compiled.

config DPA_SAMPLER
	tristate "support dpa sampler"
	default n
	help
		If you enable this option and choose 'y', it will be compiled in.
		If you choose 'm', it will be compiled as a module.
		If you choose 'n', it will not be compiled.

config DPA_SEC_CALL
	tristate "support sec call"
	default n
	help
		If you enable this option and choose 'y', it will be compiled in.
		If you choose 'm', it will be compiled as a module.
		If you choose 'n', it will not be compiled.

endmenu
```

## drivers/communication/dpa/sms/Kconfig
```kconfig
#
# dpa smart_selection configuration
#

comment "dpa smart_selection"

config DPA_WHITE_LIST
	bool "support dpa white list"
	depends on DPA_DRIVERS
	default n
	help
		This is dpa white list

config DPA_WHITE_LIST_NODE
	bool "support dpa white list node"
	depends on DPA_WHITE_LIST
	default n
	help
		This is dpa white list node

config DPA_NETDEV
	bool "support dpa net dev sync"
	depends on DPA_DRIVERS
	default n
	help
		This is dpa netdev

config DPA_SMS_GRO
	bool "support dpa gro"
	depends on DPA_DRIVERS
	default n
	help
		This is dpa gro

config DPA_SMS_GSO
	bool "support dpa tx gso csum"
	depends on DPA_DRIVERS
	default n
	help
		This is dpa sms tx

config DPA_SMS_FILTER
	bool "support dpa filter"
	depends on DPA_DRIVERS
	default n
	help
		This is dpa sms filter

config DPA_SMS
	bool "support dpa sms"
	depends on DPA_DRIVERS
	default n
	help
		This is dpa sms
```

## drivers/communication/dpa/traffic_control/Kconfig
```kconfig
#
# dpa proto tc configuration
#

comment "dpa traffic-control"

config DPA_TC
	bool "support dpa traffic-control"
	depends on DPA_DRIVERS
	default n
	help
		This is dpa traffic control
```

## drivers/communication/dpa/udx/Kconfig
```kconfig
comment "Unified Datapath Extension"

config UDX_HTTP
	bool "support udx http service"
	depends on DPA_DRIVERS
	default n
	help
		Unified Datapath Extension HTTP Service

config UDX_SERVER
	bool "support udx server"
	depends on DPA_DRIVERS
	default n
	help
		Unified Datapath Extension Server

config UDX_BUFFER
	bool "support udx buffer"
	depends on DPA_DRIVERS
	default n
	help
		Unified Datapath Extension Buffer

config UDX_DFS
	bool "support udx dfs"
	depends on DPA_DRIVERS
	default n
	help
		Unified Datapath Extension DFS

config UDX_DSS
	bool "support udx dss"
	depends on DPA_DRIVERS
	default n
	help
		Unified Datapath Extension DSS
```

## drivers/communication/interface/host/Kconfig
```kconfig
config DPA_API
	bool "support dpa interface"
	default n
	help
		If you enable this option and choose 'y', it will be compiled in.
		If you choose 'n', it will not be compiled.
```

## drivers/hisi/tzdriver/tlogger/Kconfig
```kconfig
config TEELOG
	bool "Secure Execution Log Driver"
	default n
	depends on TZDRIVER
	help
	  TEEOS log

config TEE_LOG_ACHIVE_PATH
	string "Tee log achive path"
	default "/data/log/tee/last_teemsg"
	depends on TEELOG
	help
	  Last tee msg log path

choice
	prompt "Log Exception Info"
	default TEE_DISABLE_LOG_EXCEPTION
	depends on TEELOG
 
config TEE_LOG_EXCEPTION
	bool "Log Exception Info"
 
	depends on TEELOG
	help
	  Log exception info for double_frame
 
config TEE_LOG_EXCEPTION_SINGLE
	bool "Log Exception Info"
	depends on TEELOG
	help
	  Log exception info for single_frame

config TEE_DISABLE_LOG_EXCEPTION
	bool "Disable Log Exception Info"
	depends on TEELOG
	help
	  Log exception info for disable
endchoice

choice
	prompt "Register tee log Mem"
	default PAGES_MEM
	depends on TEELOG

config RDR_MEM
	bool "Register rdr log mem"
	depends on DFX_BB
	help
	  Register rdr log mem

config BBOX_MEM
	bool "Register bbox log mem"
	depends on MNTN
	help
	  Register bbox log mem

config PAGES_MEM
	bool "Register pages log mem"
	help
	  Register pages log mem

endchoice
```

## drivers/huawei_platform/external_camera/Kconfig
```kconfig
menuconfig HUAWEI_EXTERNAL_CAMERA
	bool "huawei external CAMERA device control"
	default n
	help
	Say yes here to support external CAMERA device control.

menuconfig HUAWEI_EXTERNAL_CAMERA_MGR
	bool "huawei mgr external CAMERA device control"
	default n
	help
	Say yes here to support mgr external CAMERA device control.
```

## drivers/huawei_platform/hw_tablet/Kconfig
```kconfig
source "drivers/huawei_platform/hw_tablet/mcu/Kconfig"
source "drivers/huawei_platform/hw_tablet/dp2mipi/Kconfig"
```

## drivers/huawei_platform/mipi2hdmi/Kconfig
```kconfig
config HW_MIPI2HDMI_CONNECTOR
       bool "Huawei mipi2hdmi connector driver support"
       default n
       depends on DKMD_DPU_MIPI_DSI
       help
           Say yes here to support the huawei mipi2hdmi connector driver
```

## drivers/huawei_platform/ospm/Kconfig
```kconfig
#
# ospm driver configuration
#
 
config ARMPC_OSPM
	bool "armpc ospm drvier"
	depends on I2C
	default n
	help
	  ospm handle all os power managerment by 2012-BIOS
 
source "drivers/huawei_platform/ospm/echub/Kconfig"
source "drivers/huawei_platform/ospm/usb/multi_port/cs32g050/Kconfig"
```

## drivers/huawei_platform/ospm/echub/lid/Kconfig
```kconfig
#
# lid moudule
#

config ARMPC_ECHUB_LID
        bool "ec lid func"
        depends on ARMPC_ECHUB
        default n
        help
          This driver provides support for Lid function
          via GPIO.

config ARMPC_ECHUB_LID_TEST
        bool "lid production test"
        depends on ARMPC_ECHUB
        default n
        help
          This config provides support for Lid production test.
```

## drivers/huawei_platform/usb/usb_hisysevent/Kconfig
```kconfig
config USB_HISYSEVENT
    bool "USB Hisysevent Report"
	help
	  Say Y to enable usb hisysevent report
```

## drivers/hwnet/fltp/Kconfig
```kconfig
config HW_FL_PROTCOL
    bool "Huawei hml trans proto support"
    default n
    help
    Say yes here to support fltp
```

## drivers/hwpower/cc_hardware_monitor/teardown_detect/Kconfig
```kconfig
# SPDX-License-Identifier: GPL-2.0
#
# huawei teardown detect drivers
#

config HUAWEI_TEARDOWN_DETECT
	bool "huawei teardown detect"
	default n
	help
	  Say Y here to enable huawei teardown detect driver.
```
